## main/Kconfig.projbuild
```kconfig
menu "SHT3X Configuration"

    config TEST_SENSOR
        bool "Sensor Only"
        default y
        help
            Turn on to test if sensor code is working. 

    config TEST_RAINMAKER
        bool "Rainmaker Only"
        default y
        help
            Turn on to test if the Rainmaker code is working. 

    config HUMID_THRESHOLD
        int "Humidity Threshold"
        default 40
        help
            The minimum humidity (in %RH) where the drybox is considered too humid, 
            causing the app to alert the user. 

    config HUMID_TIMER_LENGTH
        int "Humidity Timer Length"
        default 30
        help
            The length of time (in minutes) for the drybox to be humid, before 
            the app sends a notification to the user to replace the Silica Gel. 

    config SHT3X_ADDR
        hex "I2C address of SHT3x"
        default 0x44
        help
            I2C address of SHT3x, either 0x44 or 0x45. When ADDR pin is
            grounded, choose 0x44. When ADDR pin is pulled up to VDD, choose
            0x45.

    config I2C_MASTER_SCL
        int "SCL GPIO Number"
        default 5 if IDF_TARGET_ESP8266
        default 6 if IDF_TARGET_ESP32C2 || IDF_TARGET_ESP32C3 || IDF_TARGET_ESP32C5 || IDF_TARGET_ESP32C6 || IDF_TARGET_ESP32C61
        default 19 if IDF_TARGET_ESP32 || IDF_TARGET_ESP32S2 || IDF_TARGET_ESP32S3
        default 4 if IDF_TARGET_ESP32H2
        default 4 if IDF_TARGET_ESP32P4
        help
            GPIO number for I2C Master clock line.

    config I2C_MASTER_SDA
        int "SDA GPIO Number"
        default 4 if IDF_TARGET_ESP8266
        default 5 if IDF_TARGET_ESP32C2 || IDF_TARGET_ESP32C3 || IDF_TARGET_ESP32C5 || IDF_TARGET_ESP32C6 || IDF_TARGET_ESP32C61
        default 18 if IDF_TARGET_ESP32 || IDF_TARGET_ESP32S2 || IDF_TARGET_ESP32S3
        default 3 if IDF_TARGET_ESP32H2
        default 3 if IDF_TARGET_ESP32P4
        help
            GPIO number for I2C Master data line.
endmenu
```
